## examples/nxboot-confirm/Kconfig
```kconfig
#
# For a description of the syntax of this configuration file,
# see the file kconfig-language.txt in the NuttX tools repository.
#

config EXAMPLES_NXBOOT_CONFIRM_IMAGE
	tristate "NXBoot Confirm Image Application"
	default n
	---help---
		Helper application that confirms newly updated image.

if EXAMPLES_NXBOOT_CONFIRM_IMAGE

config EXAMPLES_NXBOOT_CONFIRM_IMAGEPROGNAME
	string "Program name"
	default "nxboot_confirm"
	---help---
		This is the name of the program that will be used when the NSH ELF
		program is installed.

config EXAMPLES_NXBOOT_CONFIRM_IMAGEPRIORITY
	int "Confirm Image task priority"
	default 100

config EXAMPLES_NXBOOT_CONFIRM_IMAGESTACKSIZE
	int "Confirm Image stack size"
	default DEFAULT_TASK_STACKSIZE

endif
```

## examples/nxboot-updater/Kconfig
```kconfig
#
# For a description of the syntax of this configuration file,
# see the file kconfig-language.txt in the NuttX tools repository.
#

config EXAMPLES_NXBOOT_UPDATER
	tristate "NX image updater example"
	default n
	---help---
		Enable the updater

if EXAMPLES_NXBOOT_UPDATER

config EXAMPLES_NXBOOT_UPDATER_PROGNAME
	string "Program name"
	default "nxboot_updater"
	---help---
		This is the name of the program that will be used when the NSH ELF
		program is installed.

config EXAMPLES_NXBOOT_UPDATER_PRIORITY
	int "NX updater task priority"
	default 100

config EXAMPLES_NXBOOT_UPDATER_STACKSIZE
	int "NX updater stack size"
	default DEFAULT_TASK_STACKSIZE

endif
```

## examples/samocon-example/Kconfig
```kconfig
#
# For a description of the syntax of this configuration file,
# see the file kconfig-language.txt in the NuttX tools repository.
#

config EXAMPLES_SAMOCON_EXAMPLE
	tristate "Samocon example"
	default n
	---help---
		Enable the \"Samocon\" example

if EXAMPLES_SAMOCON_EXAMPLE

config EXAMPLES_SAMOCON_EXAMPLE_PROGNAME
	string "Program name"
	default "hello"
	---help---
		This is the name of the program that will be used when the NSH ELF
		program is installed.

config EXAMPLES_SAMOCON_EXAMPLE_PRIORITY
	int "Hello task priority"
	default 100

config EXAMPLES_SAMOCON_EXAMPLE_STACKSIZE
	int "Hello stack size"
	default DEFAULT_TASK_STACKSIZE

endif
```
